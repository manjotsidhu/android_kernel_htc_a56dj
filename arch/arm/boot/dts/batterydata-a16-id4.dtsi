/* Copyright (c) 2013, The Linux Foundation. All rights reserved.
 *
 * This program is free software; you can redistribute it and/or modify
 * it under the terms of the GNU General Public License version 2 and
 * only version 2 as published by the Free Software Foundation.
 *
 * This program is distributed in the hope that it will be useful,
 * but WITHOUT ANY WARRANTY; without even the implied warranty of
 * MERCHANTABILITY or FITNESS FOR A PARTICULAR PURPOSE.  See the
 * GNU General Public License for more details.
 */

qcom,A16DWGL-BYD-batterydata {
	qcom,fcc-mah = <2200>;
	qcom,default-rbatt-mohm = <250>;
	qcom,rbatt-capacitive-mohm = <0>;
	qcom,flat-ocv-threshold-uv = <3850000>;
	qcom,max-voltage-uv = <4400000>;
	qcom,v-cutoff-uv = <3000000>;
	qcom,chg-term-ua = <220000>;
	qcom,batt-id-kohm = <47>;
	htc,capacity = <2200>;
	htc,batt_id = <4>;
	htc,id_raw_min = <511>;
	htc,id_raw_max = <650>;
	htc,type = <1>;
	htc,model_name = "ASN";

	qcom,fcc-temp-lut {
		qcom,lut-col-legend = <(-20) (-10) 0 10 20 30 40>;
		qcom,lut-data = <1800 2110 2180 2220 2230 2230 2230>;
	};

	qcom,pc-temp-ocv-lut {
		qcom,lut-col-legend = <(-20) (-10) 0 10 20 30 40>;
		qcom,lut-row-legend = <100 95 90 85 80 75 70 65 60 55 50 45 40 35 30 25 20 15 10 9 8 7 6 5 4 3 2 1 0>;
		qcom,lut-data = <4350 4350 4350 4350 4350 4350 4350>,
				<4254 4281 4309 4318 4324 4324 4324>,
				<4176 4210 4249 4261 4267 4267 4267>,
				<4116 4150 4193 4204 4211 4211 4211>,
				<4057 4097 4139 4150 4155 4155 4155>,
				<4005 4038 4088 4097 4102 4102 4102>,
				<3964 3985 4038 4049 4052 4052 4052>,
				<3926 3940 3978 3989 4001 4001 4001>,
				<3891 3895 3930 3942 3959 3959 3959>,
				<3862 3858 3885 3892 3903 3903 3903>,
				<3842 3830 3851 3857 3863 3863 3863>,
				<3826 3811 3825 3830 3837 3837 3837>,
				<3814 3799 3804 3808 3814 3814 3814>,
				<3804 3788 3788 3789 3795 3795 3795>,
				<3793 3776 3777 3775 3778 3778 3778>,
				<3782 3762 3766 3764 3763 3763 3763>,
				<3769 3744 3749 3745 3742 3742 3742>,
				<3755 3721 3717 3710 3710 3710 3710>,
				<3739 3694 3686 3685 3687 3687 3687>,
				<3736 3689 3681 3675 3679 3679 3679>,
				<3732 3685 3676 3666 3672 3672 3672>,
				<3729 3680 3671 3657 3665 3665 3665>,
				<3725 3675 3667 3647 3658 3658 3658>,
				<3722 3671 3662 3638 3651 3651 3651>,
				<3577 3537 3529 3510 3521 3521 3521>,
				<3433 3402 3397 3383 3390 3390 3390>,
				<3289 3268 3265 3255 3260 3260 3260>,
				<3144 3134 3132 3128 3130 3130 3130>,
				<3000 3000 3000 3000 3000 3000 3000>;
	};

	qcom,rbatt-sf-lut {
		qcom,lut-col-legend = <(-20) (-10) 0 10 20 30 40>;
		qcom,lut-row-legend = <100 95 90 85 80 75 70 65 60 55 50 45 40 35 30 25 20 15 10 9 8 7 6 5 4 3 2 1 0>;
		qcom,lut-data = <222 164 154 136 78 78 78>,
				<222 164 154 136 78 78 78>,
				<222 164 154 136 78 78 78>,
				<222 164 154 136 78 78 78>,
				<222 164 154 136 78 78 78>,
				<222 164 154 136 78 78 78>,
				<222 164 154 136 78 78 78>,
				<222 164 154 136 78 78 78>,
				<222 164 154 136 78 78 78>,
				<222 164 154 136 78 78 78>,
				<222 164 154 136 78 78 78>,
				<222 164 154 136 78 78 78>,
				<222 164 154 136 78 78 78>,
				<222 164 154 136 78 78 78>,
				<222 164 154 136 78 78 78>,
				<222 164 154 136 78 78 78>,
				<222 164 154 136 78 78 78>,
				<222 164 154 136 78 78 78>,
				<222 164 154 136 78 78 78>,
				<222 164 154 136 78 78 78>,
				<222 164 154 136 78 78 78>,
				<222 164 154 136 78 78 78>,
				<222 164 154 136 78 78 78>,
				<222 164 154 136 78 78 78>,
				<222 164 154 136 78 78 78>,
				<222 164 154 136 78 78 78>,
				<222 164 154 136 78 78 78>,
				<222 164 154 136 78 78 78>,
				<222 164 154 136 78 78 78>;
		};
};

