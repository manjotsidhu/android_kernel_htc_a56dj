## drivers/i2c/sensors/sensorhub/Kconfig
```kconfig
#
# SENtral Sensor Hub driver
#

config SENTRAL_IIO
	tristate "SENtral Sensor Hub (IIO)"
	default n
	help
	  This driver supports the SENtral Sensor Hub using IIO
	  This driver can be built as a module.

config HUB_SENTRAL_MFG
	tristate "SENtral Sensor Hub MFG FLAG FOR TURN OFF AUTOK"
	depends on I2C
	default n
	help
	  sentral sensor hub MFG flag
```
